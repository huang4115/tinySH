																			  /************************************************************************************
 *  Copyright (c), 2009 -  , XXXX软件有限公司
 *            All rights reserved.
 *
 * File name: spin_lock.c
 * Project  : STM32F10X
 * Processor: STM32F10X
 * Compiler : ARM Compiler
 * 
 * Author : 李春君
 * Version: 1.00
 * Date   : 2011.3.24 
 * Email  : hevake_lcj@126.com
 * Modification: none
 * 
 * Description: 
 *   自旋锁函数定义 
 *
 * Others: none;
 *      	
 * Function List: 
 *	 1. int		XXXX(int tmp);
 *   
 * History:
 *   1. Author:       none  
 *	    Version: 	  0.0
 *	    Date:         2011.XX.XX
 *      Modification: none
 *
 ************************************************************************************
 */

/**
 ====================================================================================
 |  							   文  件  包  含									|
 |																					|
 |  NOTE: 																			|
 ====================================================================================
 */
#include "spin_lock.h"
#include "includes.h"

/**
 ====================================================================================
 |  							   宏    定    义									|
 |																					|
 |  NOTE: 																			|
 ====================================================================================
 */

/**
 ====================================================================================
 |  							  变 量 类 型 定 义									|
 |																					|
 |  NOTE: 																			|
 ====================================================================================
 */

/**
 ====================================================================================
 |  							   变  量  定  义									|
 |																					|
 |  NOTE: 																			|
 ====================================================================================
 */

/**
 ====================================================================================
 |  							 引 用 变 量 声 明									|
 |																					|
 |  NOTE: 																			|
 ====================================================================================
 */

/**
 ====================================================================================
 |  							 引 用 函 数 声 明									|
 |																					|
 |  NOTE: 																			|
 ====================================================================================
 */

/**
 ====================================================================================
 |  							   函  数  定  义									|
 |																					|
 |  NOTE: 																			|
 ====================================================================================
 */


/**
 ***********************************************************************************
 * Function: Spin_Lock;
 *
 * Description: 自旋锁上锁;
 *           
 * Input: 	--lock	锁变量
 *			--mask	锁掩码
 *          --time_out	超时时间
 *
 * Output:	none;
 *          		
 * Return:	U8	状态
 *              0：正常退出
 *              1：超时退出
 *
 * Note: 	time_out=0时表示永久等待，最长延时65.535秒
 ***********************************************************************************
 */
U8	Spin_Lock( slock_t *lock , slock_t mask , U16 time_out )
{
	U8	retval = 0 ;
#if OS_CRITICAL_METHOD == 3
    OS_CPU_SR     cpu_sr;
#endif

	while(1){
		OS_ENTER_CRITICAL();
		if(!(*lock & mask)){
			*lock |= mask ;
			OS_EXIT_CRITICAL();
			retval = 0 ;
			break;				
		}
		OS_EXIT_CRITICAL();

		OSTimeDly(1);	//一定要延时，否则低优先级的任务无法运行

		if(time_out--){
			if(time_out==0){	
				retval = 1 ;
				break;
			}
		}
	}
	return	retval;
}

/**
 ***********************************************************************************
 * Function: Spin_Unlock;
 *
 * Description: 自旋锁解锁;
 *           
 * Input: 	--lock	锁变量
 *			--mask	锁掩码
 *
 * Output:	none;
 *          		
 * Return:	none;
 *
 * Note: 
 ***********************************************************************************
 */
void	Spin_Unlock( slock_t *lock , slock_t mask )
{
#if OS_CRITICAL_METHOD == 3 
    OS_CPU_SR     cpu_sr;
#endif
	OS_ENTER_CRITICAL();
	*lock &= ~mask ;	
	OS_EXIT_CRITICAL();
}


/**
 ====================================================================================
 |  							   文  件  结  束  									|
 ====================================================================================
 */
